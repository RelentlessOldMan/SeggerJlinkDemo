; loadsave: save a memory block to a host file, load it back elsewhere, verify.
; Target workflow: dump a region to a file, then reload a binary into the target.
SYStem.CPU CortexM4
SYStem.Up
&src=0x20000300
&dst=0x20000400
; build a known pattern at src (16. is decimal; bare 16 would be hex 0x16)
&i=0
WHILE &i<16.
(
  Data.Set SD:&src+&i %Byte 0x10+&i
  &i=&i+1
)
PRINT "src0:" Data.Long(SD:0x20000300)
PRINT "srcC:" Data.Long(SD:0x2000030C)
; save src..src+15 to a temp file, then load it back at dst
Data.SAVE.Binary "~~~/cmmrun_ls.bin" 0x20000300--0x2000030F
Data.LOAD.Binary "~~~/cmmrun_ls.bin" 0x20000400
PRINT "dst0:" Data.Long(SD:0x20000400)
PRINT "dstC:" Data.Long(SD:0x2000040C)
; byte-wise verify
&ok=1
&i=0
WHILE &i<16.
(
  IF Data.Byte(SD:0x20000300+&i)!=Data.Byte(SD:0x20000400+&i)
    &ok=0
  &i=&i+1
)
IF &ok==1
  PRINT "roundtrip: ok"
ELSE
  PRINT "roundtrip: FAIL"
ENDDO
