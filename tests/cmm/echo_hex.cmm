; How hex values are stored in macros and shown by ECHO
&v=0xA
ECHO "0xA=" &v " " 0xA " &v"
&v=0xB
ECHO "0xB=" &v " " 0xB " &v"
&v=0xAB
ECHO "0xAB=" &v " " 0xAB " &v"
&v=0xF0
ECHO "0xF0=" &v " " 0xF0 " &v"
&v=0xABC
ECHO "0xABC=" &v " " 0xABC " &v"
&v=0x1F
ECHO "0x1F=" &v " " 0x1F " &v"
&v=0xFF
ECHO "0xFF=" &v " " 0xFF " &v"
&v=0xFFF
ECHO "0xFFF=" &v " " 0xFFF " &v"
&v=0xABCD
ECHO "0xABCD=" &v " " 0xABCD " &v"
&v=0x0F0
ECHO "0x0F0=" &v " " 0x0F0 " &v"
&v=0x00A
ECHO "0x00A=" &v " " 0x00A " &v"
&v=0x5+0x5
ECHO "0x5+0x5=" &v " " 0x5+0x5 " &v"
&v=0xA0
ECHO "0xA0=" &v " " 0xA0 " &v"
&v=0xC0FFEE
ECHO "0xC0FFEE=" &v " " 0xC0FFEE " &v"
&v=255.
ECHO "255.=" &v " " 255. " &v"
&v=0xA*1
ECHO "0xA*1=" &v " " 0xA*1 " &v"
&v=0x14-0xA
ECHO "0x14-0xA=" &v " " 0x14-0xA " &v"
ENDDO
