LOCAL &mode &n
&mode="Up"
&n="init"
IF TRUE()
  &mode="Down"
SYStem.&mode
GOSUB &n
ENDDO

init:
  RETURN
