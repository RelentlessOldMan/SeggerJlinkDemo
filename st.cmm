// cmmrun Tue Nov 17 14:07:50 2026

B::

; Win: GUI state, not kept by cmmrun

ENDDO
