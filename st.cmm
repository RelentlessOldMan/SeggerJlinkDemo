// cmmrun Tue Nov 17 14:11:06 2026

B::

; Win: GUI state, not kept by cmmrun

ENDDO
